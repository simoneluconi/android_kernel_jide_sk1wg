## drivers/gpu/ion/Kconfig
```kconfig
menuconfig ION
	tristate "Ion Memory Manager"
	select GENERIC_ALLOCATOR
	select DMA_SHARED_BUFFER
	help
	  Chose this option to enable the ION Memory Manager.

config ION_IOMMU
       bool

config ION_TEGRA
	tristate "Ion for Tegra"
	depends on ARCH_TEGRA && ION
	select TEGRA_IOMMU_SMMU if !ARCH_TEGRA_2x_SOC
	select ION_IOMMU if TEGRA_IOMMU_SMMU
	help
	  Choose this option if you wish to use ion on an nVidia Tegra.

config ION_SYSTEM_ONLY
	bool "Ion device with only a system heap"
	depends on ION && !ION_TEGRA
	help
	  Register /dev/ion with a single vmalloc-backed system heap, for
	  boards whose graphics use nvmap and which register no ION
	  platform device. Android's Codec2 needs ION (or DMA-BUF heaps)
	  for its linear buffers.
```
